#include <util/crc16.h>
#include "Arduino.h"
#include "Wire.h"

void setup() {
    delay(5000);
    Wire.begin();
}

#define page_size 64
#define frame_size 16
#define blank 0xff
#define pages 28
#define firmware_length 1792
#define DELAY 1
#define LEFT_ADDRESS 0x50
#define RIGHT_ADDRESS 0x53


#define ENDTRANS_SUCCESS 0
#define ENDTRANS_DATA_TOO_LONG 1
#define ENDTRANS_ADDR_NACK 2
#define ENDTRANS_DATA_NACK 3
#define ENDTRANS_ERROR 4

uint16_t offsets[pages] = {0, 64, 128, 192, 256, 320, 384, 448, 512, 576, 640, 704, 768, 832, 896, 960, 1024, 1088, 1152, 1216, 1280, 1344, 1408, 1472, 1536, 1600, 1664, 1728};
const byte firmware[firmware_length] PROGMEM = {0x1b, 0xc0, 0x35, 0xc0, 0x34, 0xc0, 0x33, 0xc0, 0x32, 0xc0, 0x31, 0xc0, 0x30,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 0xff, 0xff};

int left_written = 0;
int right_written = 0;

// The LEFT ATTiny has a reset pin directly connected to the ATMega
void reset_left_attiny() {
    // Hold the left ATTiny in reset,
    DDRC |= _BV(6);
    PORTC &= ~_BV(6);
    delay(30);
    DDRC &= ~_BV(6); // Turn the ATTiny back on
}

// The RIGHT ATTiny is on the other side of the wired i2c bus.
// Our best chance at resetting it is by toggling the current limiter.

void reset_right_attiny() {
    // Hold the left ATTiny in reset,
    DDRC |= _BV(7);
    PORTC &= ~_BV(7);
    delay(1000);
    PORTC |= _BV(7); // Turn the ATTiny back on
}
void print_result(byte result) {
    Serial.print("result = ");
    Serial.println(result);

}

int run_command(byte address, byte command) {

    Wire.beginTransmission(address);
    Wire.write(command); // erase user space
    Wire.write(0x00); // dummy end byte
    byte result = Wire.endTransmission();
    print_result(result);
    return result;
}



byte read_crc16(byte addr, byte *version, uint16_t *crc16, uint16_t offset, uint16_t length) {
    byte result = 2;

    Wire.beginTransmission(addr);
    Wire.write(0x06); // get version and CRC16
    Wire.write(offset & 0xff); // addr (lo)
    Wire.write(offset >> 8); // addr (hi)
    Wire.write(length & 0xff); // len (lo)
    Wire.write(length >> 8); // len (hi)
    result = Wire.endTransmission();
    if (result != 0) {
        return result;
    }
    Wire.requestFrom(addr, (uint8_t) 3);
    Serial.print("Available bytes: ");
    Serial.println(Wire.available());
    if (Wire.available() == 0) {
    }
    byte v = Wire.read();
    *version = v;
    if (Wire.available() == 0) {
        return 0xFF;
    }
    byte crc16_lo = Wire.read();
    if (Wire.available() == 0) {
        return 0xFF;
    }
    byte crc16_hi = Wire.read();
    while (Wire.available()) {
        byte c = Wire.read();
    }
    *crc16 = (crc16_hi << 8) | crc16_lo;
    return result;
}


void get_version (byte addr) {

    byte result = 2;
    while (result != 0) {
        Serial.print("Reading CRC16...");

        byte version;
        uint16_t crc16;
        result = read_crc16(addr, &version, &crc16, 0, firmware_length);

        Serial.print("result ");
        Serial.println(result);

        if (result != 0) {
            _delay_ms(100);
            continue;
        }
        Serial.print("Version: ");
        Serial.println(version);
        Serial.print("Existing CRC16 of 0000-1FFF: ");
        Serial.println(crc16, HEX);
    }

}



int erase_program(byte addr) {

    Serial.println("Erasing");
    Wire.beginTransmission(addr);
    Wire.write(0x04); // erase user space
    byte result = Wire.endTransmission();
    Serial.print("result = ");
    Serial.println(result);
    if (result != 0) {
        _delay_ms(1000);
        return -1;
    }
    return 0;

}


int write_firmware(byte addr ) {

    byte result = 3;
    byte o = 0;

    for (uint16_t i = 0; i < firmware_length; i += page_size) {
        Serial.print("Page ");
        Serial.print(offsets[o]);
        Serial.print(" setting address...");
        Wire.beginTransmission(addr);
        Wire.write(0x1); // write page addr
        Wire.write(offsets[o] & 0xff); // write page addr
        Wire.write(offsets[o] >> 8);
        result = Wire.endTransmission();
        _delay_ms(DELAY);
        // got something other than ACK. Start over.
        if (result != 0) {
            Serial.println("Error setting the page address");
            return -1;
        }

        // transmit each frame separately

        for (uint8_t frame = 0; frame < page_size / frame_size; frame++) {
            Wire.beginTransmission(addr);
            Wire.write(0x2); // continue page
            uint16_t crc16 = 0xffff;
            for (uint8_t j = frame * frame_size; j < (frame + 1) * frame_size; j++) {
                if (i + j < firmware_length) {
                    uint8_t b = pgm_read_byte(&firmware[i + j]);
                    Wire.write(b);
                    crc16 = _crc16_update(crc16, b);
                } else {
                    Wire.write(blank);
                    crc16 = _crc16_update(crc16, blank);
                }
            }
            // write the CRC16, little end first
            Wire.write(crc16 & 0xff);
            Wire.write(crc16 >> 8);
            Wire.write(0x00); // dummy end byte
            result = Wire.endTransmission();
            Serial.print(": frame ");
            Serial.print(frame);
            Serial.print(" = ");
            Serial.print(result);
            // got something other than NACK. Start over.
            if (result != 3) {
                Serial.println("Error: Got something other than NACK");
                return -1;
            }
            delay(DELAY);
        }
        o++;
        Serial.println("");
    }
    return 0;
}


int verify_firmware(byte addr) {
    byte result = 3;
    // verify firmware
    Serial.println("## Verifying firmware installation");
    while (result != 0) {
        Serial.print("CRC16: ");

        byte version;
        uint16_t crc16;
        // skip the first 4 bytes, are they were probably overwritten by the reset vector preservation
        result = read_crc16(addr, &version, &crc16, offsets[0] + 4, firmware_length - 4);

        Serial.println(result);

        if (result != 0) {
            _delay_ms(100);
            continue;
        }
        Serial.print("Version: ");
        Serial.println(version);
        Serial.print("CRC CRC16 of ");
        Serial.print(offsets[0] + 4, HEX);
        Serial.print("-");
        Serial.print(offsets[0] + firmware_length, HEX);
        Serial.print(": ");
        Serial.println(crc16, HEX);

        // calculate our own CRC16
        uint16_t check_crc16 = 0xffff;
        for (uint16_t i = 4; i < firmware_length; i++) {
            check_crc16 = _crc16_update(check_crc16, pgm_read_byte(&firmware[i]));
        }
        if (crc16 != check_crc16) {
            Serial.print("CRC does not match ours: ");
            Serial.println(check_crc16, HEX);
            return -1;
        }
        Serial.println("CRC check: OK");
    }
    return 0;
}

byte update_attiny(byte addr) {
    Serial.println("Communicating");

    get_version(addr);

    int erased = erase_program(addr);

    if (erased == -1) {

        Serial.println("Erase failed.");
        return 0;
    }

    int firmware_written = write_firmware(addr);
    if(firmware_written == -1) {
        Serial.println("Firmware write failed.");
        return 0;
    }

    int firmware_verified = verify_firmware(addr);
    if(firmware_verified == -1) {
        Serial.println("Firmware verify failed");
        return 0;
    }

    Serial.println("Resetting ATTiny");
    int result = run_command(addr, 0x03); // execute app
    Serial.println("Done!");

    return 1;
}

void loop() {

    delay(5000);


    if (left_written > 0 && right_written > 0 ) {

        Serial.println ("Both ATTiny MCUs have been flashed");
        Serial.println("It is now safe to reflash your keyboard with regular firmware");
        return;
    }

    Serial.println("Starting!");

    if (left_written > 0) {
        Serial.println("Already done with the left hand.");
        // we're done
    } else {
        reset_left_attiny();
        left_written = update_attiny(LEFT_ADDRESS);

    }

    if (right_written > 0) {
        Serial.println("Already done with the right hand.");
        Serial.println(right_written);
        // we're done
    } else {
        reset_right_attiny();
        right_written = update_attiny(RIGHT_ADDRESS);
    }



}



